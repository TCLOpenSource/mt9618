## arch/arm64/configs/mt5896_defconfig
```kconfig
CONFIG_ARM_MTKTV_CPUFREQ=m
CONFIG_ARM_MTKTV_CPUFREQ_CA=m
CONFIG_ARM_MTKTV_CPUFREQ_DBG=m
CONFIG_COMMON_CLK_MEDIATEK_DBG=m
CONFIG_CPU_FREQ_GOV_ONDEMAND=m
CONFIG_HWSPINLOCK_MT5896=m
CONFIG_IPACK_BUS=m
CONFIG_IR_MTK_PMU=m
CONFIG_IRS_MTK=m
CONFIG_IRTX_MTK=m
CONFIG_MIC_MUTE_MTK=m
CONFIG_KEYPAD_MT5896=m
CONFIG_KEYPAD_MTK_PMU=m
CONFIG_LCD_CLASS_DEVICE=m
CONFIG_MEDIA_ANALOG_TV_SUPPORT=y
CONFIG_MEDIA_DIGITAL_TV_SUPPORT=y
CONFIG_MEDIA_CONTROLLER_DVB=y
CONFIG_DVB_CORE=m
CONFIG_DVB_PLATFORM_DRIVERS=y
CONFIG_DVB_MMAP=y
CONFIG_DVB_DYNAMIC_MINORS=y
CONFIG_DVB_CA_EN50221_REDUCE_RESET_TIME=y
CONFIG_DVB_CA_EN50221_SLOT_INFO_CHECK_STATUS=y
# CONFIG_MEDIA_TUNER_SIMPLE is not set
# CONFIG_MEDIA_TUNER_TDA18250 is not set
# CONFIG_MEDIA_TUNER_TDA8290 is not set
# CONFIG_MEDIA_TUNER_TDA827X is not set
# CONFIG_MEDIA_TUNER_TDA18271 is not set
# CONFIG_MEDIA_TUNER_TDA9887 is not set
# CONFIG_MEDIA_TUNER_TEA5761 is not set
# CONFIG_MEDIA_TUNER_TEA5767 is not set
# CONFIG_MEDIA_TUNER_MSI001 is not set
# CONFIG_MEDIA_TUNER_MT20XX is not set
# CONFIG_MEDIA_TUNER_MT2060 is not set
# CONFIG_MEDIA_TUNER_MT2063 is not set
# CONFIG_MEDIA_TUNER_MT2266 is not set
# CONFIG_MEDIA_TUNER_MT2131 is not set
# CONFIG_MEDIA_TUNER_QT1010 is not set
# CONFIG_MEDIA_TUNER_XC2028 is not set
# CONFIG_MEDIA_TUNER_XC5000 is not set
# CONFIG_MEDIA_TUNER_XC4000 is not set
# CONFIG_MEDIA_TUNER_MXL5005S is not set
# CONFIG_MEDIA_TUNER_MXL5007T is not set
# CONFIG_MEDIA_TUNER_MC44S803 is not set
# CONFIG_MEDIA_TUNER_MAX2165 is not set
# CONFIG_MEDIA_TUNER_TDA18218 is not set
# CONFIG_MEDIA_TUNER_FC0011 is not set
# CONFIG_MEDIA_TUNER_FC0012 is not set
# CONFIG_MEDIA_TUNER_FC0013 is not set
# CONFIG_MEDIA_TUNER_TDA18212 is not set
# CONFIG_MEDIA_TUNER_E4000 is not set
# CONFIG_MEDIA_TUNER_FC2580 is not set
# CONFIG_MEDIA_TUNER_M88RS6000T is not set
# CONFIG_MEDIA_TUNER_TUA9001 is not set
# CONFIG_MEDIA_TUNER_SI2157 is not set
# CONFIG_MEDIA_TUNER_IT913X is not set
# CONFIG_MEDIA_TUNER_R820T is not set
# CONFIG_MEDIA_TUNER_MXL301RF is not set
# CONFIG_MEDIA_TUNER_QM1D1C0042 is not set
# CONFIG_MEDIA_TUNER_QM1D1B0004 is not set
# CONFIG_DVB_STB0899 is not set
# CONFIG_DVB_STB6100 is not set
# CONFIG_DVB_STV090x is not set
# CONFIG_DVB_STV0910 is not set
# CONFIG_DVB_STV6110x is not set
# CONFIG_DVB_STV6111 is not set
# CONFIG_DVB_MXL5XX is not set
# CONFIG_DVB_M88DS3103 is not set
# CONFIG_DVB_DRXK is not set
# CONFIG_DVB_TDA18271C2DD is not set
# CONFIG_DVB_SI2165 is not set
# CONFIG_DVB_MN88472 is not set
# CONFIG_DVB_MN88473 is not set
# CONFIG_DVB_CX24110 is not set
# CONFIG_DVB_CX24123 is not set
# CONFIG_DVB_MT312 is not set
# CONFIG_DVB_ZL10036 is not set
# CONFIG_DVB_ZL10039 is not set
# CONFIG_DVB_S5H1420 is not set
# CONFIG_DVB_STV0288 is not set
# CONFIG_DVB_STB6000 is not set
# CONFIG_DVB_STV0299 is not set
# CONFIG_DVB_STV6110 is not set
# CONFIG_DVB_STV0900 is not set
# CONFIG_DVB_TDA8083 is not set
# CONFIG_DVB_TDA10086 is not set
# CONFIG_DVB_TDA8261 is not set
# CONFIG_DVB_VES1X93 is not set
# CONFIG_DVB_TUNER_ITD1000 is not set
# CONFIG_DVB_TUNER_CX24113 is not set
# CONFIG_DVB_TDA826X is not set
# CONFIG_DVB_TUA6100 is not set
# CONFIG_DVB_CX24116 is not set
# CONFIG_DVB_CX24117 is not set
# CONFIG_DVB_CX24120 is not set
# CONFIG_DVB_SI21XX is not set
# CONFIG_DVB_TS2020 is not set
# CONFIG_DVB_DS3000 is not set
# CONFIG_DVB_MB86A16 is not set
# CONFIG_DVB_TDA10071 is not set
# CONFIG_DVB_SP8870 is not set
# CONFIG_DVB_SP887X is not set
# CONFIG_DVB_CX22700 is not set
# CONFIG_DVB_CX22702 is not set
# CONFIG_DVB_S5H1432 is not set
# CONFIG_DVB_DRXD is not set
# CONFIG_DVB_L64781 is not set
# CONFIG_DVB_TDA1004X is not set
# CONFIG_DVB_NXT6000 is not set
# CONFIG_DVB_MT352 is not set
# CONFIG_DVB_ZL10353 is not set
# CONFIG_DVB_DIB3000MB is not set
# CONFIG_DVB_DIB3000MC is not set
# CONFIG_DVB_DIB7000M is not set
# CONFIG_DVB_DIB7000P is not set
# CONFIG_DVB_DIB9000 is not set
# CONFIG_DVB_TDA10048 is not set
# CONFIG_DVB_AF9013 is not set
# CONFIG_DVB_EC100 is not set
# CONFIG_DVB_STV0367 is not set
# CONFIG_DVB_CXD2820R is not set
# CONFIG_DVB_CXD2841ER is not set
# CONFIG_DVB_RTL2830 is not set
# CONFIG_DVB_RTL2832 is not set
# CONFIG_DVB_RTL2832_SDR is not set
# CONFIG_DVB_SI2168 is not set
# CONFIG_DVB_ZD1301_DEMOD is not set
# CONFIG_DVB_CXD2880 is not set
# CONFIG_DVB_VES1820 is not set
# CONFIG_DVB_TDA10021 is not set
# CONFIG_DVB_TDA10023 is not set
# CONFIG_DVB_STV0297 is not set
# CONFIG_DVB_NXT200X is not set
# CONFIG_DVB_OR51211 is not set
# CONFIG_DVB_OR51132 is not set
# CONFIG_DVB_BCM3510 is not set
# CONFIG_DVB_LGDT330X is not set
# CONFIG_DVB_LGDT3305 is not set
# CONFIG_DVB_LGDT3306A is not set
# CONFIG_DVB_LG2160 is not set
# CONFIG_DVB_S5H1409 is not set
# CONFIG_DVB_AU8522_DTV is not set
# CONFIG_DVB_AU8522_V4L is not set
# CONFIG_DVB_S5H1411 is not set
# CONFIG_DVB_S921 is not set
# CONFIG_DVB_DIB8000 is not set
# CONFIG_DVB_MB86A20S is not set
# CONFIG_DVB_TC90522 is not set
# CONFIG_DVB_MN88443X is not set
# CONFIG_DVB_PLL is not set
# CONFIG_DVB_TUNER_DIB0070 is not set
# CONFIG_DVB_TUNER_DIB0090 is not set
# CONFIG_DVB_DRX39XYJ is not set
# CONFIG_DVB_LNBH25 is not set
# CONFIG_DVB_LNBH29 is not set
# CONFIG_DVB_LNBP21 is not set
# CONFIG_DVB_LNBP22 is not set
# CONFIG_DVB_ISL6405 is not set
# CONFIG_DVB_ISL6421 is not set
# CONFIG_DVB_ISL6423 is not set
# CONFIG_DVB_A8293 is not set
# CONFIG_DVB_LGS8GL5 is not set
# CONFIG_DVB_LGS8GXX is not set
# CONFIG_DVB_ATBM8830 is not set
# CONFIG_DVB_TDA665x is not set
# CONFIG_DVB_IX2505V is not set
# CONFIG_DVB_M88RS2000 is not set
# CONFIG_DVB_AF9033 is not set
# CONFIG_DVB_HORUS3A is not set
# CONFIG_DVB_ASCOT2E is not set
# CONFIG_DVB_HELENE is not set
# CONFIG_DVB_CXD2099 is not set
# CONFIG_DVB_SP2 is not set
CONFIG_ETHERNET=y
CONFIG_NET_VENDOR_MEDIATEK=y
CONFIG_MEDIATEK_DVB_ADAPTER=m
CONFIG_MEDIATEK_DVB_CI=m
CONFIG_MEDIATEK_DVB_DEMUX2=m
CONFIG_MEDIATEK_DVB_SC=m
CONFIG_MSTAR_UTIL=m
CONFIG_MT5896_SARADC=m
CONFIG_MT5896_WATCHDOG=m
CONFIG_MTKTV_CPU_THERMAL=m
CONFIG_MTKTV_GPU_THERMAL=m
CONFIG_MTKZRAM_KO=m
CONFIG_MTKZSMALLOC_KO=m
CONFIG_MTK_MZCCMDQ_HW=y
CONFIG_MTK_ZDEC=m
CONFIG_MTKZDEC_KO=m
CONFIG_MTK_ACP_MODE=y
CONFIG_MTK_BW_DBG=m
CONFIG_MTK_MEDIATOR=m
CONFIG_MTK_DRAMC=m
CONFIG_MTK_IOMMU_DTV=m
CONFIG_MTK_MIUP=m
CONFIG_MTK_MIUP_DBG=m
CONFIG_MTK_PM=m
CONFIG_MTK_BOOTTIME=m
CONFIG_MTK_FRC_MCU_RPROC=m
CONFIG_MTK_PMU_RPROC=m
CONFIG_MTK_PQU_RPROC=m
CONFIG_MTK_PQU_RPROC=m
CONFIG_MTK_REALTIME_FRAMEWORK=m
CONFIG_MTK_SMI_TV=m
CONFIG_MTK_TV_IR_DYNAMIC_CONFIG=m
CONFIG_MTK_TV_IR_IN=m
CONFIG_NET_MEDIATEK_MT5896=m
CONFIG_OPTEE=m
CONFIG_OPTEE_SHM_NUM_PRIV_PAGES=3
CONFIG_HW_RANDOM_SECURE=n
CONFIG_PHY_MTK_TPHY=m
CONFIG_PWM_MT5896=m
CONFIG_PWM_MTK_PMU=m
CONFIG_REGULATOR_MT5896=m
CONFIG_REGULATOR_MT5876=m
CONFIG_REGULATOR_MT5876_CORE_POWER=m
CONFIG_RTC_DRV_MT5896=m
CONFIG_SAMPLES=y
CONFIG_SAMPLE_MTK_RPMSG_TEST=m
CONFIG_SAMPLE_RPMSG_CLIENT=m
CONFIG_SND_DRIVERS=y
CONFIG_SND_ALOOP=m
CONFIG_SND_MT5896=m
CONFIG_SND_SOC_MEDIATEK_DTV=m
CONFIG_SPI_MT5896=m
CONFIG_TEE=m
CONFIG_TEST_POWER=m
CONFIG_USB_MTU3=m
CONFIG_USB_MU3_PHY=m
CONFIG_USB_MTK_DTV_XHCI=y
CONFIG_USB_XHCI_MTK=m
CONFIG_VIDEO_MEDIATEK_CEC=m
CONFIG_VIDEO_MEDIATEK_PMU_CEC=m
CONFIG_VIDEO_MEDIATEK_JPD=m
CONFIG_I2C_MT5896=m
CONFIG_MTK_MEMORY=m
CONFIG_SPI_MTK_RPMSGDTV=m
CONFIG_MMC_MTK_FCIE=m
CONFIG_COMMON_CLK_MEDIATEK_TV=m
CONFIG_COMMON_CLK_MT5896=m
CONFIG_MT58XX_IRQ=m
CONFIG_SERIAL_8250_MTK_TV=m
CONFIG_PINCTRL_MT5896=m
CONFIG_GPIO_MT5896=m
CONFIG_GPIO_MTK_PMU=m
CONFIG_BACKLIGHT_PWM=m
CONFIG_I2C_CHARDEV=m
CONFIG_I2C_GPIO=m
CONFIG_SPI_SPIDEV=m
CONFIG_GATOR=n
CONFIG_PCIE_MS_MTK=m
CONFIG_MTK_TV_ATRACE=m
CONFIG_BT_BNEP=m
CONFIG_BT_BNEP_MC_FILTER=y
CONFIG_BT_BNEP_PROTO_FILTER=y
CONFIG_V4L_TEST_DRIVERS=y
CONFIG_VIDEO_VIM2M=m
CONFIG_V4L_MEM2MEM_DRIVERS=y
CONFIG_LEDS_MEDIATEK_IRTX=m
CONFIG_LEDS_GPIO=m
CONFIG_LEDS_BREATH=m
CONFIG_ION_CMA_HEAP=m
CONFIG_RPMSG_VIRTIO=m
CONFIG_EXTCON=m
CONFIG_EXTCON_MTK_HEADSET=m
CONFIG_MTK_BDMA=m
CONFIG_MT5896_MBOX=m
CONFIG_PWM_ADC_MT5896=m
CONFIG_I2C_MT5896_RPROC=m
CONFIG_MTK_TTY_PROXY_UART=m
CONFIG_MTK_TTY_VIRTUAL_UART=m
CONFIG_MTK_GPU_SUPPORT=m
CONFIG_ZSMALLOC=m
CONFIG_ZRAM=m
```

## drivers/media/dvb-frontends/cxd2878/Kconfig
```kconfig
# SPDX-License-Identifier: GPL-2.0

config DVB_CXD2878
	tristate "Sony CXD2878 ATSC/ATSC3.0 demodulator"
	depends on DVB_CORE && I2C
	default m
	help
	  Say Y when you want to support this frontend.
```

## drivers/misc/mediatek/irq_async/Kconfig
```kconfig
config MTK_IRQ_ASYNC
	tristate "mtk irq async probe enhance"
	help
	  GKI have data racing issue when the
	  irq probe asynchronously, this driver
	  add a mutex to protect the race code
	  via kprobe. Remove this driver after
	  upstream fix it.
```

## drivers/soc/mediatek/mtk-memory/Kconfig
```kconfig
config MTK_MEMORY
	tristate "MediaTek Memory Support"
	depends on MTK_MIUP
	default y
        help
	  Say yes here to add support for the MediaTek Memory driver.

config MTK_NULLMEMORY_32BITS_WORKAROUND
	bool "arm 32 bits nullmemroy workaround"
	default n
	help
	  Say yes if use aarch32 kernel and have null memory application.
```
