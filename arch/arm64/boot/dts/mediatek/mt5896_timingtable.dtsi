// SPDX-License-Identifier: (GPL-2.0 OR BSD-3-Clause)
/*
 * Copyright (c) 2020 MediaTek Inc.
 */

/ {
	timing_table {
		timing_num = <142>;
		/* status bit 0: SRCCAP_TIMINGDETECT_FLAG_POL_HPVP */
		/* status bit 1: SRCCAP_TIMINGDETECT_FLAG_POL_HPVN */
		/* status bit 2: SRCCAP_TIMINGDETECT_FLAG_POL_HNVP */
		/* status bit 3: SRCCAP_TIMINGDETECT_FLAG_POL_HNVN */
		/* status bit 4: SRCCAP_TIMINGDETECT_FLAG_INTERLACED */
		/* status bit 5: SRCCAP_TIMINGDETECT_FLAG_CE_TIMING */
		/* status bit 6: SRCCAP_TIMINGDETECT_FLAG_YPBPR*/
		/* status bit 7: SRCCAP_TIMINGDETECT_FLAG_HDMI */
		/* status bit 8: SRCCAP_TIMINGDETECT_FLAG_DVI */
		/* status bit 9: SRCCAP_TIMINGDETECT_FLAG_VGA */

		timings =
			/* hfreq vfreq hstart vstart hde vde htt vtt adcphase status */

			/* 640x350 */
			< 314 59200 80 3 640 350 800 369 63 0x384 >,
			< 315 70000 141 59 640 350 800 449 38 0x382 >,
			< 379 85080 160 63 640 350 832 445 63 0x382 >, // VESA MTS

			/* 640x400 */
			< 315 70000 156 33 640 400 800 449 63 0x384 >,
			< 379 85080 160 44 640 400 832 445 63 0x384 >, // VESA Std.

			/* 720x400 */
			< 315 70000 158 34 720 400 900 449 43 0x380 >,
			< 379 85039 180 45 720 400 936 446 63 0x384 >, // VESA MTS

			/* 640x480 */
			< 300 57100 138 31 640 480 800 525 63 0x388 >,
			< 315 59940 136 27 640 480 800 525 37 0x3a8 >, // VESA Std.
			< 350 66700 156 38 640 480 864 525 60 0x388 >,
			< 379 72809 160 23 640 480 832 520 58 0x388 >, // VESA Std.
			< 375 75000 184 19 640 480 840 500 57 0x388 >, // VESA Std.
			< 433 85008 136 28 640 480 832 509 63 0x388 >, // VESA Std.

			/* 720x480 */
			/* interlaced */
			< 156 60000 45 24 720 480 858 525 60 0x3f0 >,
			/* progressive */
			< 156 30000 59 26 720 480 858 525 31 0x3e0 >,
			< 351 59800 163 15 720 480 891 587 31 0x3c8 >,
			< 315 60000 47 26 720 480 858 525 46 0x3e0 >,

			/* 848x480 */
			< 298 59600 180 11 848 480 1056 500 39 0x3c4 >,
			< 310 60000 224 31 848 480 1088 517 18 0x3c1 >, // VESA MTS

			/* 1440x480 */
			/* interlaced */
			< 157 59940 238 18 1440 480 1716 525 5 0x3f8 >,

			/* 720x576 */
			/* interlaced */
			< 156 50000 57 31 720 576 864 625 59 0x3f0 >,
			/* progressive */
			< 313 50000 56 35 720 576 864 625 59 0x3e0 >,
			< 357 59800 163 15 720 576 912 597 31 0x3c4 >,

			/* 1440x576 */
			/* interlaced */
			< 156 50000 264 22 1440 576 1728 625 5 0x3b8 >,

			/* 800x600 */
			< 352 56250 200 24 800 600 1024 625 4 0x381 >, // VESA MTS
			< 379 60317 216 27 800 600 1056 628 48 0x381 >, // VESA Std.
			< 481 72188 184 29 800 600 1040 666 6 0x381 >, // VESA Std.
			< 469 75000 240 24 800 600 1056 625 42 0x381 >, // VESA Std.
			< 537 85061 216 30 800 600 1048 631 63 0x381 >, // VESA Std.

			/* 832x624 */
			< 497 74600 283 36 832 624 1152 667 44 0x388 >,

			/* 864x648 */
			< 403 60000 212 17 864 648 1120 671 63 0x384 >,

			/* 1280X720 */
			< 180 24000 260 25 1280 720 3300 750 5 0x3e1 >,
			< 188 25000 260 25 1280 720 3960 750 5 0x3e1 >,
			< 225 30000 260 25 1280 720 3300 750 5 0x3e1 >,
			< 375 50000 252 16 1280 720 1980 750 5 0x3e0 >,
			< 450 60000 250 16 1280 720 1650 750 5 0x3e0 >,
			< 564 75000 329 26 1280 720 1696 752 45 0x3c4 >,

			/* 1024x768 */
			/* interlaced */
			< 355 86957 232 24 1024 768 1264 817 63 0x390 >, // VESA DMT
			/* progressive */
			< 484 60004 296 35 1024 768 1344 806 63 0x384 >, // VESA DMT & Std.
			< 565 70069 280 35 1024 768 1328 806 0 0x388 >, // VESA DMT & Std.
			< 602 74900 269 27 1024 768 1328 804 41 0x388 >,
			< 600 75029 272 31 1024 768 1312 800 41 0x381 >, // VESA DMT & Std.
			< 687 84997 304 39 1024 768 1376 808 63 0x381 >, // VESA DMT & Std.

			/* 1280x768 */
			< 395 50000 307 14 1280 768 1648 791 19 0x381 >,
			< 478 59870 320 27 1280 768 1664 798 38 0x384 >, // VESA DMT & CVT
			< 474 59995 112 19 1280 768 1440 790 38 0x382 >, // VESA RB DMT & CVT
			< 603 74893 336 34 1280 768 1696 805 19 0x384 >, // VESA DMT & CVT
			< 602 74800 329 26 1280 768 1696 805 19 0x388 >,

			/* 1360x768 */
			< 477 60015 368 24 1360 768 1792 795 34 0x381 >, // VESA DMT

			/* 1366x768 */
			< 477 59790 356 27 1366 768 1792 798 47 0x381 >, // VESA DMT & Std.
			< 480 60000 120 31 1366 768 1500 800 38 0x381 >, // VESA RB DMT
			< 491 60000 346 32 1366 768 1780 817 47 0x388 >,

			/* 1280x800 */
			< 497 59810 328 28 1280 800 1680 831 63 0x384 >, // VESA DMT & Std. & CVT
			< 625 74900 349 36 1280 800 1712 835 63 0x384 >,

			/* 1152x864 */
			< 543 60000 285 36 1152 864 1472 905 51 0x381 >,
			< 639 70200 288 49 1152 864 1472 912 63 0x381 >,
			< 675 75000 384 35 1152 864 1600 900 17 0x381 >, // VESA DMT & Std.
			< 771 85000 360 42 1152 864 1552 910 63 0x384 >,

			/* 1152X870 */
			< 541 59900 304 25 1152 870 1520 903 63 0x384 >,
			< 689 75100 265 38 1152 870 1456 916 27 0x388 >,

			/* 1152x900 */
			< 619 66000 334 29 1152 900 1528 937 27 0x388 >,

			/* 1440x900 */
			< 559 59887 384 31 1440 900 1904 934 14 0x384 >, // VESA DMT & Std. & CVT
			< 555 59901 112 23 1440 900 1600 926 14 0x382 >, // VESA RB DMT & CVT
			< 706 74900 248 33 1440 900 1936 942 63 0x384 >,

			/* 1600x900 */
			< 557 59800 239 25 1600 900 2128 932 63 0x384 >,
			< 560 59916 430 31 1600 900 2122 934 5 0x384 >, // VESA CVT
			< 600 60000 176 99 1600 900 1800 1000 5 0x381 >, // VESA RB DMT & Std.
			< 702 74700 248 33 1600 900 2160 940 63 0x384 >,

			/* 1280x960 */
			< 600 60000 424 39 1280 960 1800 1000 17 0x381 >, // VESA DMT & Std.
			< 750 75000 381 35 1280 960 1728 1002 17 0x381 >,
			< 859 85002 384 50 1280 960 1728 1011 63 0x381 >, // VESA DMT & Std.

			/* 1280x1024 */
			< 633 59900 345 28 1280 1024 1712 1063 2 0x388 >,
			< 640 60020 360 41 1280 1024 1688 1066 34 0x381 >, // VESA DMT & Std.
			< 744 70000 375 54 1280 1024 1680 1600 58 0x381 >,
			< 760 72000 375 54 1280 1024 1712 1064 58 0x381 >,
			< 800 75025 392 41 1280 1024 1688 1066 2 0x381 >, // VESA DMT & Std.
			< 811 76000 343 31 1280 1024 1664 1066 58 0x388 >,
			< 911 85024 384 47 1280 1024 1728 1072 63 0x381 >, // VESA DMT & Std.

			/* 1600x1024 */
			< 621 59700 154 20 1600 1024 1808 1040 56 0x388 >,
			< 802 75000 154 20 1600 1024 2176 1069 63 0x384 >,

			/* 1400x1050 */
			< 647 59948 112 27 1400 1050 1560 1080 63 0x382 >, // VESA RB DMT & CVT
			< 647 59900 232 32 1400 1050 1560 1080 63 0x384 >,
			< 653 59978 376 36 1400 1050 1864 1089 63 0x384 >, // VESA DMT & Std. & CVT
			< 823 74800 382 41 1400 1050 1896 1099 63 0x388 >,

			/* 1680x1050 */
			< 647 59883 112 27 1680 1050 1840 1080 32 0x382 >, // VESA RB DMT & CVT
			< 646 59800 108 19 1680 1050 1840 1080 32 0x384 >,
			< 653 59954 456 36 1680 1050 2240 1089 6 0x384 >, // VESA DMT & Std. & CVT
			< 823 74800 296 40 1680 1050 2272 1099 63 0x388 >,

			/* 1920x1080 */
			/* interlaced */
			< 281 50000 180 23 1920 1080 2640 1125 6 0x3f0 >,
			< 338 60000 177 22 1920 1080 2200 1125 5 0x3f0 >,
			< 313 50000 304 152 1920 1080 2376 1250 31 0x3f0 >,
			< 667 60000 109 21 1920 1080 2080 1111 18 0x3d2 >,
			/* progressive */
			< 270 24000 177 33 1920 1080 2750 1125 33 0x3e0 >,
			< 281 25000 179 33 1920 1080 2640 1125 33 0x3e0 >,
			< 338 30000 179 32 1920 1080 2200 1125 33 0x3e0 >,
			< 563 50000 183 32 1920 1080 2640 1125 23 0x3e0 >,
			< 675 60000 177 32 1920 1080 2200 1125 18 0x3e0 >, // VESA DMT & Std.
			< 1125 100000 192 41 1920 1080 2640 1125 5 0x3e1 >,
			< 1350 120000 192 41 1920 1080 2200 1125 5 0x3e1 >,
			< 1693 144000 376 89 1920 1080 2672 1177 5 0x381 >, // cvt
			< 1666 144000 80 69 1920 1080 2080 1157 5 0x381 >, // cvt-RB
			< 1666 144000 40 6 1920 1080 2000 1157 5 0x381 >, // cvt-RBv2

			/* 1600x1200 */
			< 648 51800 496 46 1600 1200 2160 1250 63 0x381 >,
			< 741 59900 146 20 1600 1200 1760 1236 17 0x382 >,
			< 750 60000 496 49 1600 1200 2160 1250 63 0x381 >, // VESA DMT & Std.
			< 813 65000 496 49 1600 1200 2160 1250 57 0x381 >, // VESA DMT & Std.
			< 875 70000 496 49 1600 1200 2160 1250 63 0x381 >, // VESA DMT & Std.
			< 938 75000 496 49 1600 1200 2160 1250 17 0x381 >, // VESA DMT & Std.

			/* 1920x1200 */
			< 740 59900 110 30 1920 1200 2080 1235 63 0x382 >,
			< 745 59900 500 40 1920 1200 2592 1245 49 0x388 >,
			< 812 65000 496 49 1920 1200 2592 1248 63 0x384 >,
			< 940 74900 344 49 1920 1200 2608 1255 63 0x384 >,

			/* 2560x1440 */
			< 895 59926 744 50 2560 1440 3490 1493 5 0x384 >, // VESA CVT
			< 1854 119978 792 102 2560 1440 3574 1545 5 0x384 >, // VESA CVT
			< 736 50000 79 31 2560 1440 2719 1481 5 0x381 >,
			< 2257 144000 512 120 2560 1440 3584 1568 5 0x381 >, // cvt
			< 2222 144000 80 95 2560 1440 2720 1543 5 0x381 >, // cvt-RB
			< 2222 144000 40 6 2560 1440 2640 1543 5 0x381 >, // cvt-RBv2

			/* 2048x1536 */
			< 954 59900 600 53 2048 1536 2800 1592 5 0x384 >, // VESA DMT & CVT

			/* 2560x1600 */
			< 994 59900 700 55 2560 1600 3504 1658 5 0x384 >, // VESA DMT & CVT

			/* 3840x2160 */
			< 540 24000 384 82 3840 2160 5500 2250 5 0x3a1 >,
			< 563 25000 384 82 3840 2160 5280 2250 5 0x3a1 >,
			< 675 30000 384 82 3840 2160 4400 2250 5 0x3a1 >,
			< 1125 50000 384 82 3840 2160 5280 2250 5 0x3a1 >,
			< 1350 60000 384 82 3840 2160 4400 2250 5 0x3a1 >,
			< 2250 100000 384 82 3840 2160 5280 2250 5 0x3a1 >,
			< 2700 120000 384 82 3840 2160 4400 2250 5 0x3a1 >,
			< 3382 144000 784 182 3840 2160 5408 2350 5 0x381 >, // cvt
			< 3332 144000 80 146 3840 2160 4000 2314 5 0x381 >, // cvt-RB
			< 3332 144000 40 6 3840 2160 3920 2314 5 0x381 >, // cvt-RBv2

			/* 4096x2160 */
			< 540 24000 384 82 4096 2160 5500 2250 5 0x3a1 >,
			< 563 25000 216 82 4096 2160 5280 2250 5 0x3a1 >,
			< 675 30000 216 82 4096 2160 4400 2250 5 0x3a1 >,
			< 1125 50000 216 82 4096 2160 5280 2250 5 0x3a1 >,
			< 1350 60000 216 82 4096 2160 4400 2250 5 0x3a1 >,
			< 2250 100000 384 82 4096 2160 5280 2250 5 0x3a1 >,
			< 2700 120000 216 82 4096 2160 4400 2250 5 0x3a1 >,

			/* 7680x4320 */
			< 1080 24000 768 164 7680 4320 11000 4500 5 0x3a1 >,
			< 1100 25000 768 64 7680 4320 10800 4400 5 0x3a1 >,
			< 1320 30000 768 64 7680 4320 9000 4400 5 0x3a1 >,
			< 2200 50000 768 64 7680 4320 10800 4400 5 0x3a1 >,
			< 2640 60000 768 64 7680 4320 9000 4400 5 0x3a1 >;
	};
};

