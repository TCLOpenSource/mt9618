// SPDX-License-Identifier: (GPL-2.0 OR BSD-3-Clause)
/*
 * Copyright (c) 2020 MediaTek Inc.
 */

#include <dt-bindings/clock/merak-clk.h>
#include "merak_clk/mt5896_top_clock.dtsi"
#include "merak_clk/mt5896_top_mg_clock.dtsi"
#include "merak_clk/mt5896_vivaldi9_clock_fix.dtsi"
#include "merak_clk/mt5896_vivaldi9_clock.dtsi"
#include "merak_clk/mt5896_audio_clock.dtsi"
#include "merak_clk/mt5896_memc2_swen_clock.dtsi"
#include "merak_clk/mt5896_mod_clock.dtsi"
#include "merak_clk/mt5896_tsp_fix_clock.dtsi"
#include "merak_clk/mt5896_tsp_clock.dtsi"
#include "merak_clk/mt5896_adc_fix.dtsi"
#include "merak_clk/mt5896_adcpll_clock.dtsi"
#include "merak_clk/mt5896_nonpm_adc_clock.dtsi"
#include "merak_clk/mt5896_pm_adc_clock.dtsi"
#include "merak_clk/merak_test_clock.dtsi"
#include "merak_clk/mt5896_uart_clock.dtsi"
#include "merak_clk/mt5896_b2r_clock.dtsi"
#include "merak_clk/mt5896_smart_clock.dtsi"
#include "merak_clk/mt5896_scsrc_clock.dtsi"
#include "merak_clk/mt5896_scdv_clock.dtsi"
#include "merak_clk/mt5896_scace_clock.dtsi"
#include "merak_clk/mt5896_scmw_clock.dtsi"
#include "merak_clk/mt5896_sctcon_clock.dtsi"
#include "merak_clk/mt5896_scsr_clock.dtsi"
#include "merak_clk/mt5896_scpq_clock.dtsi"
#include "merak_clk/mt5896_scscl_clock.dtsi"
#include "merak_clk/mt5896_scnr_clock.dtsi"
#include "merak_clk/mt5896_scip_clock.dtsi"
#include "merak_clk/mt5896_jpd_clock.dtsi"
#include "merak_clk/mt5896_usb_pm_clock.dtsi"
#include "merak_clk/mt5896_usb_nonpm_clock.dtsi"
#include "merak_clk/mt5896_vd_clock.dtsi"
#include "merak_clk/mt5896_vd_special.dtsi"
#include "merak_clk/mt5896_hdmi_clock.dtsi"
#include "merak_clk/mt5896_i2c_clock.dtsi"
#include "merak_clk/mt5896_pm_fix.dtsi"
#include "merak_clk/mt5896_pm_clock.dtsi"
#include "merak_clk/mt5896_pwm_nonpm_clock.dtsi"
#include "merak_clk/mt5896_fcie_clock.dtsi"
#include "merak_clk/mt5896_ge_clock.dtsi"
#include "merak_clk/mt5896_ufs_clock.dtsi"
#include "merak_clk/mt5896_earc_clock.dtsi"
#include "merak_clk/mt5896_earc_clock_special.dtsi"
#include "merak_clk/mt5896_cvbso_clock.dtsi"
#include "merak_clk/merak_clk_test_ctrl.dtsi"
#include "merak_clk/mt5896_venc_swen_clock.dtsi"
#include "merak_clk/mt5896_memc_clock.dtsi"
#include "merak_clk/mt5896_memc_mg_clock.dtsi"

#include "merak_clk/mt5897_swen_clock.dtsi"
#include "merak_clk/mt5897_vdec_mg_clock.dtsi"
#include "merak_clk/mt5897_vdec_swen_clock.dtsi"
#include "merak_clk/mt5896_xc_clock.dtsi"
/*#include "merak_clk/mt5897_xcgate_clock.dtsi"*/
#include "merak_clk/xc96e3_swen_clock.dtsi"
#include "merak_clk/mt5876_memc2_swen.dtsi"
#include "merak_clk/mt5876_xc76_swen_clock.dtsi"
#include "merak_clk/mt5876_pcm_swen_clock.dtsi"
#include "merak_clk/mt5897_memc97_swen_clock.dtsi"
