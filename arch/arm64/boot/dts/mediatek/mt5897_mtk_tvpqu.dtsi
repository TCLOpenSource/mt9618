// SPDX-License-Identifier: (GPL-2.0 OR BSD-3-Clause)

/ {
	mtk_tvpqu: mtk-tvpqu {
		compatible = "mediatek,tvpqu";
		memory-region = <&MI_DISP_PQ_MEMORY &MI_DISP_SRS_MEMORY>;
		alg_header_info = <0x40>;
	};

};
