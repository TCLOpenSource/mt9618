// SPDX-License-Identifier: (GPL-2.0 OR BSD-3-Clause)
/*
 * Copyright (c) 2020 MediaTek Inc.
 */

/ {
	#address-cells = <2>;
	#size-cells = <2>;

	signal_test_ctrl: signal_test_ctrl {
		compatible = "mediatek,signal_test_ctrl";
	};
};
