// SPDX-License-Identifier: (GPL-2.0 OR BSD-3-Clause)
/*
 * Copyright (c) 2020 MediaTek Inc.
 */

/ {
	#address-cells = <2>;
	#size-cells = <2>;

	mtk_boottime {
		compatible = "mtk_boottime";
		reg =   <0x0 0x1c401200 0 0x100>,
			<0x0 0x1c606A00 0 0x100>;
	};
};
