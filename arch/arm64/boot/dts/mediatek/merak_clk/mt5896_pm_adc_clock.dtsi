// SPDX-License-Identifier: (GPL-2.0 OR BSD-3-Clause)
/*
 * Copyright (c) 2020 MediaTek Inc.
 */


/ {
	pm_adc_OOXX: pm_adc_swen {
		#clock-cells = <1>;
		compatible = "mediatek,dtv_clk_gate_en";
		num = <CLK_PM_ADC_EN_NR>;

		sd2pm {
			id = <CLK_PM_ADC_EN_SD2PM>;
			parent = "sd2pm_int_ck";
		};

	};
};
