// SPDX-License-Identifier: (GPL-2.0 OR BSD-3-Clause)
/*
 * Copyright (c) 2020 MediaTek Inc.
 */

/{
	pcm_OOXX: pcm_swen {
		#clock-cells = <1>;
		compatible = "mediatek,dtv_clk_gate_en";
		num = <2>;


		pcm2piu {
			id = <1>;
			parent = "pcm_int_ck";
		};

	};
};
